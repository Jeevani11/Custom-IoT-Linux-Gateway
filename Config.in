## Config.in
```kconfig
menu "IoT Gateway packages"

source "$BR2_EXTERNAL_IOT_GATEWAY_PATH/package/python-adafruit-platformdetect/Config.in"
source "$BR2_EXTERNAL_IOT_GATEWAY_PATH/package/python-adafruit-pureio/Config.in"
source "$BR2_EXTERNAL_IOT_GATEWAY_PATH/package/python-adafruit-blinka/Config.in"
source "$BR2_EXTERNAL_IOT_GATEWAY_PATH/package/python-adafruit-dht/Config.in"

endmenu
```

## package/python-adafruit-blinka/Config.in
```kconfig
config BR2_PACKAGE_PYTHON_ADAFRUIT_BLINKA
    bool "python-adafruit-blinka"
    depends on BR2_PACKAGE_PYTHON3
    select BR2_PACKAGE_PYTHON_ADAFRUIT_PLATFORMDETECT
    select BR2_PACKAGE_PYTHON_ADAFRUIT_PUREIO
    select BR2_PACKAGE_PYTHON_GPIOD
    select BR2_PACKAGE_PYTHON_SYSV_IPC
    select BR2_PACKAGE_LIBGPIOD2
```

## package/python-adafruit-dht/Config.in
```kconfig
config BR2_PACKAGE_PYTHON_ADAFRUIT_DHT
    bool "python-adafruit-dht"
    depends on BR2_PACKAGE_PYTHON3
    select BR2_PACKAGE_PYTHON_ADAFRUIT_BLINKA
```

## package/python-adafruit-platformdetect/Config.in
```kconfig
config BR2_PACKAGE_PYTHON_ADAFRUIT_PLATFORMDETECT
    bool "python-adafruit-platformdetect"
    depends on BR2_PACKAGE_PYTHON3
```

## package/python-adafruit-pureio/Config.in
```kconfig
config BR2_PACKAGE_PYTHON_ADAFRUIT_PUREIO
    bool "python-adafruit-pureio"
    depends on BR2_PACKAGE_PYTHON3
```
